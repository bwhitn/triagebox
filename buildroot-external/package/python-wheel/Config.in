## buildroot-external/package/python-wheel/Config.in
```kconfig
config BR2_PACKAGE_PYTHON_WHEEL
	bool "python-wheel"
	depends on BR2_PACKAGE_PYTHON3
	help
	  Build and install Python wheel archives.

	  https://wheel.readthedocs.io/
```

## buildroot-external/package/python-xdis/Config.in
```kconfig
config BR2_PACKAGE_PYTHON_XDIS
	bool "python-xdis"
	depends on BR2_PACKAGE_PYTHON3
	select BR2_PACKAGE_PYTHON_CLICK
	help
	  Python cross-version byte-code disassembler and marshal routines

	  https://github.com/rocky/python-xdis/
```

## buildroot-external/package/python-xlmmacrodeobfuscator/Config.in
```kconfig
config BR2_PACKAGE_PYTHON_XLMMACRODEOBFUSCATOR
	bool "python-xlmmacrodeobfuscator"
	depends on BR2_PACKAGE_PYTHON3
	select BR2_PACKAGE_PYTHON_LARK
	select BR2_PACKAGE_PYTHON_UNTANGLE
	help
	  XLMMacroDeobfuscator is an XLM Emulation engine written in Python 3, designed to analyze and deobfuscate malicious XLM macros, also known as Excel 4.0 macros, contained in MS Excel files (XLS, XLSM, and XLSB).

	  https://github.com/DissectMalware/XLMMacroDeobfuscator
```

## buildroot-external/package/python-xlrd2/Config.in
```kconfig
config BR2_PACKAGE_PYTHON_XLRD2
	bool "python-xlrd2"
	depends on BR2_PACKAGE_PYTHON3
	help
	  Library for developers to extract data from Microsoft Excel legacy spreadsheet files (xls)

	  https://pypi.org/project/xlrd2/
```

## buildroot-external/package/qpdf11/Config.in
```kconfig
config BR2_PACKAGE_QPDF11
	bool "qpdf11"
	depends on BR2_INSTALL_LIBSTDCPP
	depends on BR2_TOOLCHAIN_GCC_AT_LEAST_5
	depends on BR2_TOOLCHAIN_HAS_ATOMIC
	select BR2_PACKAGE_ZLIB
	select BR2_PACKAGE_JPEG
	help
	  qpdf11 is a C++ library and command-line tool for structural,
	  content-preserving transformations of PDF files.

	  This package tracks qpdf 11.x for compatibility with python-pikepdf.

	  https://github.com/qpdf/qpdf

comment "qpdf11 needs a toolchain w/ C++, gcc >= 5"
	depends on BR2_TOOLCHAIN_HAS_ATOMIC
	depends on !BR2_INSTALL_LIBSTDCPP || \
		!BR2_TOOLCHAIN_GCC_AT_LEAST_5
```

## buildroot-external/package/radare2/Config.in
```kconfig
config BR2_PACKAGE_RADARE2
	bool "radare2"
	help
	  The UNIX-like reverse engineering framework and command-line toolkit.
```

## buildroot-external/package/refinery-generated-deps/Config.in
```kconfig
source "$BR2_EXTERNAL_NIXBROWSER_PATH/package/python-access-parser/Config.in"
source "$BR2_EXTERNAL_NIXBROWSER_PATH/package/python-capstone/Config.in"
source "$BR2_EXTERNAL_NIXBROWSER_PATH/package/python-compressed-rtf/Config.in"
source "$BR2_EXTERNAL_NIXBROWSER_PATH/package/python-decompyle3/Config.in"
source "$BR2_EXTERNAL_NIXBROWSER_PATH/package/python-dictdumper/Config.in"
source "$BR2_EXTERNAL_NIXBROWSER_PATH/package/python-evtx/Config.in"
source "$BR2_EXTERNAL_NIXBROWSER_PATH/package/python-extract-msg/Config.in"
source "$BR2_EXTERNAL_NIXBROWSER_PATH/package/python-hexdump/Config.in"
source "$BR2_EXTERNAL_NIXBROWSER_PATH/package/python-inflate64/Config.in"
source "$BR2_EXTERNAL_NIXBROWSER_PATH/package/python-icicle-emu/Config.in"
source "$BR2_EXTERNAL_NIXBROWSER_PATH/package/python-javaobj-py3/Config.in"
source "$BR2_EXTERNAL_NIXBROWSER_PATH/package/python-jsbeautifier/Config.in"
source "$BR2_EXTERNAL_NIXBROWSER_PATH/package/python-lief/Config.in"
source "$BR2_EXTERNAL_NIXBROWSER_PATH/package/python-lnkparse3/Config.in"
source "$BR2_EXTERNAL_NIXBROWSER_PATH/package/python-lznt1/Config.in"
source "$BR2_EXTERNAL_NIXBROWSER_PATH/package/python-magic/Config.in"
source "$BR2_EXTERNAL_NIXBROWSER_PATH/package/python-minidump/Config.in"
source "$BR2_EXTERNAL_NIXBROWSER_PATH/package/python-multivolumefile/Config.in"
source "$BR2_EXTERNAL_NIXBROWSER_PATH/package/python-msoffcrypto-tool/Config.in"
source "$BR2_EXTERNAL_NIXBROWSER_PATH/package/python-olefile/Config.in"
source "$BR2_EXTERNAL_NIXBROWSER_PATH/package/python-oletools/Config.in"
source "$BR2_EXTERNAL_NIXBROWSER_PATH/package/python-openpyxl/Config.in"
source "$BR2_EXTERNAL_NIXBROWSER_PATH/package/python-phpserialize/Config.in"
source "$BR2_EXTERNAL_NIXBROWSER_PATH/package/python-pefile-target/Config.in"
source "$BR2_EXTERNAL_NIXBROWSER_PATH/package/python-pikepdf/Config.in"
source "$BR2_EXTERNAL_NIXBROWSER_PATH/package/python-py7zr/Config.in"
source "$BR2_EXTERNAL_NIXBROWSER_PATH/package/python-pycdlib/Config.in"
source "$BR2_EXTERNAL_NIXBROWSER_PATH/package/python-pyonenote/Config.in"
source "$BR2_EXTERNAL_NIXBROWSER_PATH/package/python-pyperclip/Config.in"
source "$BR2_EXTERNAL_NIXBROWSER_PATH/package/python-pyppmd/Config.in"
source "$BR2_EXTERNAL_NIXBROWSER_PATH/package/python-pyzbar/Config.in"
source "$BR2_EXTERNAL_NIXBROWSER_PATH/package/python-pyxlsb2/Config.in"
source "$BR2_EXTERNAL_NIXBROWSER_PATH/package/python-pyzstd/Config.in"
source "$BR2_EXTERNAL_NIXBROWSER_PATH/package/python-registry/Config.in"
source "$BR2_EXTERNAL_NIXBROWSER_PATH/package/python-pybcj/Config.in"
source "$BR2_EXTERNAL_NIXBROWSER_PATH/package/python-smda/Config.in"
source "$BR2_EXTERNAL_NIXBROWSER_PATH/package/python-spark-parser/Config.in"
source "$BR2_EXTERNAL_NIXBROWSER_PATH/package/python-speakeasy-emulator-refined/Config.in"
source "$BR2_EXTERNAL_NIXBROWSER_PATH/package/python-tbtrim/Config.in"
source "$BR2_EXTERNAL_NIXBROWSER_PATH/package/python-uncompyle6/Config.in"
source "$BR2_EXTERNAL_NIXBROWSER_PATH/package/python-unicorn/Config.in"
source "$BR2_EXTERNAL_NIXBROWSER_PATH/package/python-untangle/Config.in"
source "$BR2_EXTERNAL_NIXBROWSER_PATH/package/python-wheel-target/Config.in"
source "$BR2_EXTERNAL_NIXBROWSER_PATH/package/python-xdis/Config.in"
source "$BR2_EXTERNAL_NIXBROWSER_PATH/package/python-xlmmacrodeobfuscator/Config.in"
source "$BR2_EXTERNAL_NIXBROWSER_PATH/package/python-xlrd2/Config.in"
```

## buildroot-external/package/yara-x/Config.in
```kconfig
config BR2_PACKAGE_YARA_X
	bool "yara-x"
	depends on BR2_PACKAGE_HOST_RUSTC_TARGET_ARCH_SUPPORTS
	select BR2_PACKAGE_HOST_RUSTC
	help
	  YARA-X is the Rust implementation of YARA from VirusTotal.
	  This package installs the upstream CLI (`yr`) and also provides
	  a `yara-x` symlink for convenience.

	  https://github.com/VirusTotal/yara-x

comment "yara-x needs a toolchain w/ Rust target support"
	depends on !BR2_PACKAGE_HOST_RUSTC_TARGET_ARCH_SUPPORTS
```
