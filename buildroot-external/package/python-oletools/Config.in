## buildroot-external/package/python-oletools/Config.in
```kconfig
config BR2_PACKAGE_PYTHON_OLETOOLS
	bool "python-oletools"
	depends on BR2_PACKAGE_PYTHON3
	help
	  Python tools to analyze security characteristics of MS Office and OLE files (also called Structured Storage, Compound File Binary Format or Compound Document File Format), for Malware Analysis and Incident Response #DFIR

	  https://github.com/decalage2/oletools
```

## buildroot-external/package/python-openpyxl/Config.in
```kconfig
config BR2_PACKAGE_PYTHON_OPENPYXL
	bool "python-openpyxl"
	depends on BR2_PACKAGE_PYTHON3
	help
	  A Python library to read/write Excel 2010 xlsx/xlsm files

	  https://openpyxl.readthedocs.io
```

## buildroot-external/package/python-pefile-target/Config.in
```kconfig
config BR2_PACKAGE_PYTHON_PEFILE_TARGET
	bool "python-pefile-target"
	depends on BR2_PACKAGE_PYTHON3
	help
	  Read and work with Portable Executable (PE) files.

	  https://github.com/erocarrera/pefile
```

## buildroot-external/package/python-pefile/Config.in
```kconfig
config BR2_PACKAGE_PYTHON_PEFILE
	bool "python-pefile"
	depends on BR2_PACKAGE_PYTHON3
	help
	  Read and work with Portable Executable (PE) files.

	  https://github.com/erocarrera/pefile
```

## buildroot-external/package/python-phpserialize/Config.in
```kconfig
config BR2_PACKAGE_PYTHON_PHPSERIALIZE
	bool "python-phpserialize"
	depends on BR2_PACKAGE_PYTHON3
	help
	  a port of the serialize and unserialize functions of php to python.

	  http://github.com/mitsuhiko/phpserialize
```

## buildroot-external/package/python-pikepdf/Config.in
```kconfig
config BR2_PACKAGE_PYTHON_PIKEPDF
	bool "python-pikepdf"
	depends on BR2_PACKAGE_PYTHON3
	select BR2_PACKAGE_QPDF11
	help
	  Read and write PDFs with Python, powered by qpdf

	  https://pypi.org/project/pikepdf/
```

## buildroot-external/package/python-py7zr/Config.in
```kconfig
config BR2_PACKAGE_PYTHON_PY7ZR
	bool "python-py7zr"
	depends on BR2_PACKAGE_PYTHON3
	select BR2_PACKAGE_PYTHON_INFLATE64
	select BR2_PACKAGE_PYTHON_MULTIVOLUMEFILE
	select BR2_PACKAGE_PYTHON_PYBCJ
	help
	  Pure python 7-zip library

	  https://pypi.org/project/py7zr/
```

## buildroot-external/package/python-pybcj/Config.in
```kconfig
config BR2_PACKAGE_PYTHON_PYBCJ
	bool "python-pybcj"
	depends on BR2_PACKAGE_PYTHON3
	help
	  BCJ filter encoder/decoder used by py7zr.

	  https://pypi.org/project/pybcj/
```

## buildroot-external/package/python-pycdlib/Config.in
```kconfig
config BR2_PACKAGE_PYTHON_PYCDLIB
	bool "python-pycdlib"
	depends on BR2_PACKAGE_PYTHON3
	help
	  Pure python ISO manipulation library

	  http://github.com/clalancette/pycdlib
```

## buildroot-external/package/python-pyonenote/Config.in
```kconfig
config BR2_PACKAGE_PYTHON_PYONENOTE
	bool "python-pyonenote"
	depends on BR2_PACKAGE_PYTHON3
	help
	  pyOneNote is a lightweight python library to read OneNote files. The main goal of this parser is to allow cybersecurity analyst to extract useful information, such as embedded files, from OneNote files.

	  https://github.com/DissectMalware/pyOneNote
```

## buildroot-external/package/python-pypcapkit/Config.in
```kconfig
config BR2_PACKAGE_PYTHON_PYPCAPKIT
	bool "python-pypcapkit"
	depends on BR2_PACKAGE_PYTHON3
	select BR2_PACKAGE_PYTHON_AENUM
	select BR2_PACKAGE_PYTHON_DICTDUMPER
	select BR2_PACKAGE_PYTHON_TBTRIM
	help
	  PyPCAPKit: comprehensive network packet analysis library

	  https://pypi.org/project/pypcapkit/
```

## buildroot-external/package/python-pyperclip/Config.in
```kconfig
config BR2_PACKAGE_PYTHON_PYPERCLIP
	bool "python-pyperclip"
	depends on BR2_PACKAGE_PYTHON3
	help
	  A cross-platform clipboard module for Python. (Only handles plain text for now.)

	  https://pypi.org/project/pyperclip/
```

## buildroot-external/package/python-pyppmd/Config.in
```kconfig
config BR2_PACKAGE_PYTHON_PYPPMD
	bool "python-pyppmd"
	depends on BR2_PACKAGE_PYTHON3
	help
	  PPMd compression/decompression library

	  https://pypi.org/project/pyppmd/
```

## buildroot-external/package/python-pyxlsb2/Config.in
```kconfig
config BR2_PACKAGE_PYTHON_PYXLSB2
	bool "python-pyxlsb2"
	depends on BR2_PACKAGE_PYTHON3
	help
	  Excel 2007+ Binary Workbook (xlsb) parser

	  https://github.com/DissectMalware/pyxlsb2
```

## buildroot-external/package/python-pyzbar/Config.in
```kconfig
config BR2_PACKAGE_PYTHON_PYZBAR
	bool "python-pyzbar"
	depends on BR2_PACKAGE_PYTHON3
	depends on BR2_TOOLCHAIN_HAS_THREADS
	depends on BR2_USE_MMU
	depends on BR2_INSTALL_LIBSTDCPP
	depends on BR2_TOOLCHAIN_HEADERS_AT_LEAST_3_0
	select BR2_PACKAGE_ZBAR
	help
	  Read one-dimensional barcodes and QR codes from Python.

	  https://github.com/NaturalHistoryMuseum/pyzbar/

comment "python-pyzbar needs a toolchain w/ threads, C++ and headers >= 3.0"
	depends on BR2_PACKAGE_PYTHON3
	depends on !BR2_USE_MMU || !BR2_TOOLCHAIN_HAS_THREADS \
		|| !BR2_INSTALL_LIBSTDCPP || !BR2_TOOLCHAIN_HEADERS_AT_LEAST_3_0
```

## buildroot-external/package/python-pyzstd/Config.in
```kconfig
config BR2_PACKAGE_PYTHON_PYZSTD
	bool "python-pyzstd"
	depends on BR2_PACKAGE_PYTHON3
	help
	  Support for Zstandard (zstd) compression

	  https://pypi.org/project/pyzstd/
```

## buildroot-external/package/python-registry/Config.in
```kconfig
config BR2_PACKAGE_PYTHON_REGISTRY
	bool "python-registry"
	depends on BR2_PACKAGE_PYTHON3
	help
	  Read access to Windows Registry files.

	  http://www.williballenthin.com/registry/
```

## buildroot-external/package/python-smda/Config.in
```kconfig
config BR2_PACKAGE_PYTHON_SMDA
	bool "python-smda"
	depends on BR2_PACKAGE_PYTHON3
	help
	  A recursive disassmbler optimized for CFG recovery from memory dumps. Based on capstone.

	  https://github.com/danielplohmann/smda
```

## buildroot-external/package/python-spark-parser/Config.in
```kconfig
config BR2_PACKAGE_PYTHON_SPARK_PARSER
	bool "python-spark-parser"
	depends on BR2_PACKAGE_PYTHON3
	help
	  Generic parser framework used by decompyle3 and related tools.

	  https://pypi.org/project/spark-parser/
```

## buildroot-external/package/python-speakeasy-emulator-refined/Config.in
```kconfig
config BR2_PACKAGE_PYTHON_SPEAKEASY_EMULATOR_REFINED
	bool "python-speakeasy-emulator-refined"
	depends on BR2_PACKAGE_PYTHON3
	select BR2_PACKAGE_PYTHON_JSONSCHEMA
	help
	  Speakeasy malware emulation framework

	  https://github.com/binref/speakeasy
```

## buildroot-external/package/python-tbtrim/Config.in
```kconfig
config BR2_PACKAGE_PYTHON_TBTRIM
	bool "python-tbtrim"
	depends on BR2_PACKAGE_PYTHON3
	help
	  Lightweight traceback trimming helper used by pcapkit.

	  https://pypi.org/project/tbtrim/
```

## buildroot-external/package/python-uncompyle6/Config.in
```kconfig
config BR2_PACKAGE_PYTHON_UNCOMPYLE6
	bool "python-uncompyle6"
	depends on BR2_PACKAGE_PYTHON3
	help
	  Python cross-version byte-code decompiler

	  https://github.com/rocky/python-uncompyle6/
```

## buildroot-external/package/python-unicorn/Config.in
```kconfig
config BR2_PACKAGE_PYTHON_UNICORN
	bool "python-unicorn"
	depends on BR2_PACKAGE_PYTHON3
	help
	  Unicorn CPU emulator engine

	  https://pypi.org/project/unicorn/
```

## buildroot-external/package/python-untangle/Config.in
```kconfig
config BR2_PACKAGE_PYTHON_UNTANGLE
	bool "python-untangle"
	depends on BR2_PACKAGE_PYTHON3
	help
	  Convert XML documents to Python objects.

	  https://pypi.org/project/untangle/
```

## buildroot-external/package/python-wheel-target/Config.in
```kconfig
config BR2_PACKAGE_PYTHON_WHEEL_TARGET
	bool "python-wheel-target"
	depends on BR2_PACKAGE_PYTHON3
	help
	  Build and install Python wheel archives.

	  https://wheel.readthedocs.io/
```
