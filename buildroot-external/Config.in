## buildroot-external/Config.in
```kconfig
menu "TriageBox packages"
	source "$BR2_EXTERNAL_TRIAGEBOX_PATH/package/radare2/Config.in"
	source "$BR2_EXTERNAL_TRIAGEBOX_PATH/package/pdfid/Config.in"
	source "$BR2_EXTERNAL_TRIAGEBOX_PATH/package/pdf-parser/Config.in"
	source "$BR2_EXTERNAL_TRIAGEBOX_PATH/package/qpdf11/Config.in"
	source "$BR2_EXTERNAL_TRIAGEBOX_PATH/package/yara-x/Config.in"
	source "$BR2_EXTERNAL_TRIAGEBOX_PATH/package/python-binary-refinery/Config.in"
	source "$BR2_EXTERNAL_TRIAGEBOX_PATH/package/refinery-generated-deps/Config.in"
endmenu
```

## buildroot-external/package/pdf-parser/Config.in
```kconfig
config BR2_PACKAGE_PDF_PARSER
	bool "pdf-parser"
	select BR2_PACKAGE_PYTHON3
	help
	  Didier Stevens' pdf-parser tool for PDF object and stream analysis.
```

## buildroot-external/package/pdfid/Config.in
```kconfig
config BR2_PACKAGE_PDFID
	bool "pdfid"
	select BR2_PACKAGE_PYTHON3
	help
	  Didier Stevens' PDFID tool for quick PDF feature triage.
```

## buildroot-external/package/python-access-parser/Config.in
```kconfig
config BR2_PACKAGE_PYTHON_ACCESS_PARSER
	bool "python-access-parser"
	depends on BR2_PACKAGE_PYTHON3
	help
	  Access database (*.mdb, *.accdb) parser

	  https://github.com/ClarotyICS/access_parser
```

## buildroot-external/package/python-backports-lzma/Config.in
```kconfig
config BR2_PACKAGE_PYTHON_BACKPORTS_LZMA
	bool "python-backports-lzma"
	depends on BR2_PACKAGE_PYTHON3
	help
	  Backport of Python 3.3's lzma module.

	  https://pypi.org/project/backports.lzma/
```

## buildroot-external/package/python-binary-refinery/Config.in
```kconfig
config BR2_PACKAGE_PYTHON_BINARY_REFINERY
	bool "python-binary-refinery"
	depends on BR2_PACKAGE_PYTHON3
	depends on BR2_i386
	depends on BR2_TOOLCHAIN_USES_GLIBC
	help
	  Binary Refinery is a toolkit for byte-level malware and payload
	  analysis/transformation.
	  This package installs Binary Refinery and the full upstream
	  optional dependency set ([all]) from Python wheels targeting
	  i686 manylinux/glibc, including LIEF.

	  https://github.com/binref/refinery

comment "python-binary-refinery needs an i386 glibc toolchain"
	depends on BR2_PACKAGE_PYTHON3
	depends on !BR2_i386 || !BR2_TOOLCHAIN_USES_GLIBC
```

## buildroot-external/package/python-capstone/Config.in
```kconfig
config BR2_PACKAGE_PYTHON_CAPSTONE
	bool "python-capstone"
	depends on BR2_PACKAGE_PYTHON3
	help
	  Capstone disassembly engine

	  https://www.capstone-engine.org
```

## buildroot-external/package/python-compressed-rtf/Config.in
```kconfig
config BR2_PACKAGE_PYTHON_COMPRESSED_RTF
	bool "python-compressed-rtf"
	depends on BR2_PACKAGE_PYTHON3
	help
	  Compressed Rich Text Format (RTF) compression and decompression package

	  https://github.com/delimitry/compressed_rtf
```

## buildroot-external/package/python-decompyle3/Config.in
```kconfig
config BR2_PACKAGE_PYTHON_DECOMPYLE3
	bool "python-decompyle3"
	depends on BR2_PACKAGE_PYTHON3
	select BR2_PACKAGE_PYTHON_SPARK_PARSER
	select BR2_PACKAGE_PYTHON_XDIS
	help
	  Python cross-version byte-code decompiler

	  https://github.com/rocky/python-decompile3/
```

## buildroot-external/package/python-dictdumper/Config.in
```kconfig
config BR2_PACKAGE_PYTHON_DICTDUMPER
	bool "python-dictdumper"
	depends on BR2_PACKAGE_PYTHON3
	help
	  Dumper for Python dictionaries in various output formats.

	  https://pypi.org/project/dictdumper/
```

## buildroot-external/package/python-evtx/Config.in
```kconfig
config BR2_PACKAGE_PYTHON_EVTX
	bool "python-evtx"
	depends on BR2_PACKAGE_PYTHON3
	help
	  Pure Python parser for Windows event log files (.evtx).

	  https://pypi.org/project/python-evtx/
```

## buildroot-external/package/python-extract-msg/Config.in
```kconfig
config BR2_PACKAGE_PYTHON_EXTRACT_MSG
	bool "python-extract-msg"
	depends on BR2_PACKAGE_PYTHON3
	help
	  Extracts emails and attachments saved in Microsoft Outlook's .msg files

	  https://github.com/TeamMsgExtractor/msg-extractor
```

## buildroot-external/package/python-hexdump/Config.in
```kconfig
config BR2_PACKAGE_PYTHON_HEXDUMP
	bool "python-hexdump"
	depends on BR2_PACKAGE_PYTHON3
	help
	  dump binary data to hex format and restore from there

	  https://bitbucket.org/techtonik/hexdump/
```

## buildroot-external/package/python-icicle-emu/Config.in
```kconfig
config BR2_PACKAGE_PYTHON_ICICLE_EMU
	bool "python-icicle-emu"
	depends on BR2_PACKAGE_PYTHON3
	help
	  Python bindings for the Icicle emulator.

	  https://pypi.org/project/icicle-emu/
```

## buildroot-external/package/python-inflate64/Config.in
```kconfig
config BR2_PACKAGE_PYTHON_INFLATE64
	bool "python-inflate64"
	depends on BR2_PACKAGE_PYTHON3
	help
	  DEFLATE64 implementation used by py7zr.

	  https://pypi.org/project/inflate64/
```

## buildroot-external/package/python-javaobj-py3/Config.in
```kconfig
config BR2_PACKAGE_PYTHON_JAVAOBJ_PY3
	bool "python-javaobj-py3"
	depends on BR2_PACKAGE_PYTHON3
	help
	  Module for serializing and de-serializing Java objects.

	  https://github.com/tcalmant/python-javaobj
```

## buildroot-external/package/python-jsbeautifier/Config.in
```kconfig
config BR2_PACKAGE_PYTHON_JSBEAUTIFIER
	bool "python-jsbeautifier"
	depends on BR2_PACKAGE_PYTHON3
	help
	  JavaScript unobfuscator and beautifier.

	  https://beautifier.io
```

## buildroot-external/package/python-lief/Config.in
```kconfig
config BR2_PACKAGE_PYTHON_LIEF
	bool "python-lief"
	depends on BR2_PACKAGE_PYTHON3
	help
	  Library to instrument executable formats

	  https://pypi.org/project/lief/
```

## buildroot-external/package/python-lnkparse3/Config.in
```kconfig
config BR2_PACKAGE_PYTHON_LNKPARSE3
	bool "python-lnkparse3"
	depends on BR2_PACKAGE_PYTHON3
	select BR2_PACKAGE_PYTHON_PYYAML
	help
	  Windows Shortcut file (LNK) parser

	  https://github.com/Matmaus/LnkParse
```

## buildroot-external/package/python-lznt1/Config.in
```kconfig
config BR2_PACKAGE_PYTHON_LZNT1
	bool "python-lznt1"
	depends on BR2_PACKAGE_PYTHON3
	help
	  Python module for LZNT1 compression/decompression

	  https://github.com/you0708/lznt1/
```

## buildroot-external/package/python-magic/Config.in
```kconfig
config BR2_PACKAGE_PYTHON_MAGIC
	bool "python-magic"
	depends on BR2_PACKAGE_PYTHON3
	help
	  File type identification using libmagic

	  http://github.com/ahupp/python-magic
```

## buildroot-external/package/python-minidump/Config.in
```kconfig
config BR2_PACKAGE_PYTHON_MINIDUMP
	bool "python-minidump"
	depends on BR2_PACKAGE_PYTHON3
	help
	  Python library to parse Windows minidump file format

	  https://github.com/skelsec/minidump
```

## buildroot-external/package/python-msoffcrypto-tool/Config.in
```kconfig
config BR2_PACKAGE_PYTHON_MSOFFCRYPTO_TOOL
	bool "python-msoffcrypto-tool"
	depends on BR2_PACKAGE_PYTHON3
	help
	  Python tool and library for decrypting and encrypting MS Office files using a password or other keys

	  https://github.com/nolze/msoffcrypto-tool
```

## buildroot-external/package/python-multivolumefile/Config.in
```kconfig
config BR2_PACKAGE_PYTHON_MULTIVOLUMEFILE
	bool "python-multivolumefile"
	depends on BR2_PACKAGE_PYTHON3
	help
	  Multi-volume virtual file helper used by py7zr.

	  https://pypi.org/project/multivolumefile/
```

## buildroot-external/package/python-olefile/Config.in
```kconfig
config BR2_PACKAGE_PYTHON_OLEFILE
	bool "python-olefile"
	depends on BR2_PACKAGE_PYTHON3
	help
	  Python package to parse, read and write Microsoft OLE2 files (Structured Storage or Compound Document, Microsoft Office)

	  https://www.decalage.info/python/olefileio
```
